## main/Kconfig.projbuild
```kconfig
menu "SD/MMC Configuration"

    config KK_FORMAT_IF_MOUNT_FAILED
        bool "Format the card if mount failed"
        default n
        help
            If this config item is set, format_if_mount_failed will be set to true and the card will be formatted if
            the mount has failed.

    choice KK_SDMMC_BUS_WIDTH
        prompt "SD/MMC bus width"
        default KK_SDMMC_BUS_WIDTH_1
        help
            Select the bus width of SD or MMC interface.
            Note that even if 1 line mode is used, D3 pin of the SD card must have a pull-up resistor connected.
            Otherwise the card may enter SPI mode, the only way to recover from which is to cycle power to the card.

        config KK_SDMMC_BUS_WIDTH_4
            bool "4 lines (D0 - D3)"

        config KK_SDMMC_BUS_WIDTH_1
            bool "1 line (D0)"
    endchoice

    if SOC_SDMMC_USE_GPIO_MATRIX

        config KK_PIN_CMD
            int "CMD GPIO number"
            default 35 if IDF_TARGET_ESP32S3

        config KK_PIN_CLK
            int "CLK GPIO number"
            default 36 if IDF_TARGET_ESP32S3

        config KK_PIN_D0
            int "D0 GPIO number"
            default 37 if IDF_TARGET_ESP32S3

        if KK_SDMMC_BUS_WIDTH_4

            config KK_PIN_D1
                int "D1 GPIO number"
                default 38 if IDF_TARGET_ESP32S3

            config KK_PIN_D2
                int "D2 GPIO number"
                default 33 if IDF_TARGET_ESP32S3

            config KK_PIN_D3
                int "D3 GPIO number"
                default 34 if IDF_TARGET_ESP32S3

        endif  # KK_SDMMC_BUS_WIDTH_4

    endif  # SOC_SDMMC_USE_GPIO_MATRIX

endmenu

menu "KK HTTP Configuration"

    config KK_BASIC_AUTH
        bool "Basic Authentication"
        default n
        help
            Basic Authentication is a method for an HTTP user agent (e.g. a web browser)
            to provide a user name and password when making a request. It is the simplest
            technique for enforcing access controls to web resources. because it doesn't
            require cookies, session identifiers, or login pages; rather, it uses standard
            fields in the HTTP header.
            Note that, Basic Authentication is not encrypted channel and also easy to retrieve
            credentials as they are sent in plain text format.

    config KK_BASIC_AUTH_USERNAME
        string "Basic Authenticate User Name"
        depends on KK_BASIC_AUTH
        default "ESP32"
        help
            The client's user name which used for basic authenticate.

    config KK_BASIC_AUTH_PASSWORD
        string "Basic Authenticate Password"
        depends on KK_BASIC_AUTH
        default "ESP32Webserver"
        help
            The client's password which used for basic authenticate.
            
    config KK_ENABLE_HTTPS_USER_CALLBACK
        bool "Enable user callback with HTTPS Server"
        select ESP_TLS_SERVER_MIN_AUTH_MODE_OPTIONAL
        help
            Enable user callback for esp_https_server which can be used to get SSL context (connection information)
            E.g. Certificate of the connected client
            
    config KK_HTTPD_CONN_CLOSE_HEADER
        bool "Send connection close header from request handlers"
        default y
        help
            If this config item is set, Connection: close header will be set in handlers.
            This closes HTTP connection and frees the server socket instantly.
endmenu

menu "KK Camera Configuration"
	choice BOARD
		bool "Select Board"
		default BOARD_ESP32CAM_AITHINKER
		help
			Select Board Type.
			
		config BOARD_WROVER_KIT
			bool "Freenove ESP32-WROVER CAM Board"
		config BOARD_CAMERA_MODEL_ESP_EYE
			bool "Espressif ESP-EYE"
		config BOARD_ESP32CAM_AITHINKER
			bool "AiThinker ESP32-CAM"
		config BOARD_CAMERA_MODEL_TTGO_T_JOURNAL
			bool "TTGO T-Journal ESP32 Camera"
	endchoice

	choice FRAMESIZE
		bool "Select Frame Size"
		default FRAMESIZE_VGA
		help
			Select Picture Frame Size.

		config FRAMESIZE_VGA
			bool "Frame Size:640x480"
		config FRAMESIZE_SVGA
			bool "Frame Size:800x600"
		config FRAMESIZE_XGA
			bool "Frame Size:1024x768"
		config FRAMESIZE_HD
			bool "Frame Size:1280x720"
		config FRAMESIZE_SXGA
			bool "Frame Size:1280x1024"
		config FRAMESIZE_UXGA
			bool "Frame Size:1600x1200"
	endchoice
endmenu

menu "KK RTC Configuration"
	choice RTC_TYPE
		bool "Select RTC Type"
		default RTC_DS1307
		help
			Select RTC module type.
			
		config RTC_DS1307
			bool "DS1307"
		config RTC_DS3231
			bool "DS3231"
	endchoice
endmenu
```
